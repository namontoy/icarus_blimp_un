## firmware/projects/optflow_cam/main/Kconfig.projbuild
```kconfig
menu "Optical Flow Configuration"

    choice OPTFLOW_BOARD
        prompt "Camera board"
        default OPTFLOW_BOARD_S3_WROOM_CAM if IDF_TARGET_ESP32S3
        default OPTFLOW_BOARD_AI_THINKER
        help
            Selects the pin map in camera_pins.h.

        config OPTFLOW_BOARD_AI_THINKER
            bool "AI-Thinker ESP32-CAM"
            depends on IDF_TARGET_ESP32
        config OPTFLOW_BOARD_S3_WROOM_CAM
            bool "ESP32-S3-WROOM CAM (Freenove pin map, OV3660)"
            depends on IDF_TARGET_ESP32S3
            help
                The ESP32-S3-WROOM CAM board with the Freenove / ESP32-S3-EYE
                camera pin map (docs/s3-wroom-cam-wiring-plan.md), fitted with
                an OV3660. The OV2640 also works on it; the OV3660 frame timing
                below applies only when the sensor reports PID 0x3660.
        config OPTFLOW_BOARD_ESP_EYE
            bool "ESP-EYE"
        config OPTFLOW_BOARD_XIAO_S3
            bool "Seeed XIAO ESP32S3 Sense"
    endchoice

    choice OPTFLOW_FRAME
        prompt "Frame size (grayscale)"
        default OPTFLOW_FRAME_QVGA if OPTFLOW_BOARD_S3_WROOM_CAM
        default OPTFLOW_FRAME_QQVGA
        help
            The matcher's cost follows grid^2 x (2*search+1)^2 x block^2, and
            the search radius must grow with the frame width to keep the same
            velocity range, so the frame size is decided by the match time,
            not by the camera or the memory. host/size_bench (make bench) and
            OPTFLOW_BENCH measure it; docs/esp32-cam-optical-flow-report.md
            section 13 has the table. QVGA with a 4x4 grid is the largest that
            keeps 80 ms with margin by that table; CIF fits only on paper.

        config OPTFLOW_FRAME_QQVGA
            bool "QQVGA 160x120"
        config OPTFLOW_FRAME_HQVGA
            bool "HQVGA 240x176"
        config OPTFLOW_FRAME_QVGA
            bool "QVGA 320x240"
        config OPTFLOW_FRAME_CIF
            bool "CIF 400x296"
    endchoice

    config OPTFLOW_S3_UART
        bool "Copy the CSV rows to the flight board on UART1"
        depends on OPTFLOW_BOARD_AI_THINKER || OPTFLOW_BOARD_S3_WROOM_CAM
        default y
        help
            Every CSV row also goes out on UART1 for the S3-Zero to read and
            log (its cam_link.c tells these rows from target_cam's by their 16
            columns). Only data rows; the 's' command stops the PC copy only.
            Nothing reads RX. Pins are in camera_pins.h: TX IO14 and RX IO13 on
            the AI-Thinker (target_cam's wiring); TX IO14 and RX IO21 on the
            S3-WROOM CAM, whose IO13 is the camera's PCLK.

    config OPTFLOW_S3_UART_BAUD
        int "Flight-board UART baud rate"
        depends on OPTFLOW_S3_UART
        range 9600 2000000
        default 115200
        help
            The S3 reads its camera UART at 115200. A ~90-byte row takes about
            8 ms on the wire, well within the 80 ms frame period.

    config OPTFLOW_FRAME_PERIOD_MS
        int "OV3660 frame period (ms, 0 = the driver's own timing)"
        range 0 200
        default 80
        help
            With an OV3660, set the sensor's own frame length so that it
            delivers one frame every this many milliseconds; the loop then
            takes every frame, as it does on the AI-Thinker, where the OV2640
            at XCLK 20 MHz happens to run at 79.95 ms. The esp32-camera driver
            clocks the OV3660 at SYSCLK = XCLK for QVGA to HVGA in grayscale,
            which by its own timing gives about 90 ms at XCLK 20 MHz; this
            raises SYSCLK to 40 MHz (it needs an XCLK that divides 160 MHz)
            and stretches the vertical blanking to the period. Reasoned from
            the driver's PLL formula, not measured: the boot banner prints the
            period actually measured. Ignored for other sensors.

    config OPTFLOW_TARGET_FPS
        int "Target frame rate (frames per second)"
        range 1 30
        default 15
        help
            Frames are paced to this rate deliberately. Optical flow for a blimp
            needs nothing faster, and running the sensor slower is the single
            most effective way to keep an ESP32-CAM cool. Changeable at runtime
            with the 'f' command.

    config OPTFLOW_XCLK_MHZ
        int "Sensor clock XCLK (MHz)"
        range 4 20
        default 10
        help
            The OV2640 pixel pipeline is clocked from this. 20 MHz is the usual
            example value; 10 MHz halves the sensor's own dissipation and is
            still far more bandwidth than a paced 15 FPS QQVGA stream needs.
            Below about 6 MHz some OV2640 modules fail to produce frames.

    config OPTFLOW_HEIGHT_MM
        int "Default height above the floor (mm)"
        range 100 10000
        default 2000
        help
            Used to convert pixel flow into millimetres per second. Pixel flow
            scales with 1/height, so this number must be right - or supplied by
            a rangefinder in flight. Changeable at runtime with the 'h' command.

    config OPTFLOW_HFOV_DEG
        int "Horizontal field of view (degrees)"
        range 10 150
        default 54
        help
            Horizontal FOV of the lens at the configured frame size. 54 degrees
            is the computed horizontal component of the stock OV2640 65-degree
            diagonal lens at 4:3. CALIBRATE THIS: it is a direct scale factor on
            every velocity this firmware reports.

    config OPTFLOW_BLOCK
        int "Match block size (pixels)"
        range 8 32
        default 16

    config OPTFLOW_SEARCH
        int "Search radius (pixels)"
        range 1 10
        default 10 if OPTFLOW_FRAME_CIF
        default 8 if OPTFLOW_FRAME_QVGA
        default 7
        help
            Bounds the largest measurable motion to search - 1 px per frame:
            at 2 m, 12.5 FPS and a 58 degree lens, 7 at QQVGA is about
            +/-1.0 m/s, 8 at QVGA about +/-0.6 m/s. Larger costs cycles
            quadratically.

    config OPTFLOW_GRID
        int "Grid of match blocks (N x N)"
        range 1 8
        default 4 if OPTFLOW_FRAME_QVGA || OPTFLOW_FRAME_CIF
        default 5
        help
            N*N blocks are matched per frame and the median is reported, so a
            person walking underneath cannot drag the estimate with them.

    config OPTFLOW_MIN_VAR
        int "Minimum block variance to attempt a match"
        range 0 10000
        default 50
        help
            A featureless floor patch has no recoverable motion. Blocks below
            this are reported as rejected rather than matched to noise.

    config OPTFLOW_BENCH
        bool "Run the frame-size benchmark at boot"
        default n
        help
            Before the camera starts, time flow_match on synthetic frames at
            every candidate frame size (main/flow_bench.c, the table host/
            size_bench prints) with the frames in internal RAM and in PSRAM,
            print the table, then carry on as usual. It needs no camera, so
            it runs on any board of the target. About 30 s at boot.

endmenu
```

## firmware/projects/target_cam/main/Kconfig.projbuild
```kconfig
menu "Target Camera Configuration"

    choice TARGETCAM_BOARD
        prompt "Camera board"
        default TARGETCAM_BOARD_AI_THINKER
        help
            Selects the pin map in camera_pins.h.

        config TARGETCAM_BOARD_AI_THINKER
            bool "AI-Thinker ESP32-CAM"
        config TARGETCAM_BOARD_ESP_EYE
            bool "ESP-EYE"
        config TARGETCAM_BOARD_XIAO_S3
            bool "Seeed XIAO ESP32S3 Sense"
    endchoice

    config TARGETCAM_FRAME_PERIOD_MS
        int "Frame period (milliseconds)"
        range 33 1000
        default 80
        help
            Rows come every n-th sensor frame, n chosen so the period is
            closest to this. The sensor is the clock: the loop takes each
            frame as the OV2640 completes it. At XCLK 20 MHz that is every
            79.968 ms (1 599 360 XCLK cycles, from the driver's frame
            timestamps on 2026-10-14), so 80 gives every frame, 12.5 FPS, and
            nothing shorter exists. An earlier build paced on the FreeRTOS
            tick at exactly 80 ms, assuming the two stayed locked; they beat
            instead, and a frame was missed about every 200 s. Changeable at
            runtime with 'f<fps>', which accepts decimals ('f12.5').

    config TARGETCAM_XCLK_MHZ
        int "Sensor clock XCLK (MHz)"
        range 4 20
        default 20
        help
            The OV2640 frame period scales inversely with XCLK: optflow_cam
            measured 159.9 ms at 10 MHz and 80.00 ms at 20 MHz. 10 MHz runs
            cooler and caps the stream at 6.25 FPS; the frame period follows
            it, since the loop is paced by the sensor.

    config TARGETCAM_HFOV_DEG
        int "Horizontal field of view (degrees)"
        range 10 150
        default 54
        help
            Converts pixel position into bearing, and apparent size into range.
            54 degrees is the computed horizontal component of the stock OV2640
            65-degree diagonal lens at 4:3. CALIBRATE THIS: it scales every
            bearing and range this firmware reports.

    config TARGETCAM_VFLIP
        bool "Flip the image vertically"
        default n
        help
            Set this if the camera is mounted upside down on the airframe, so
            that +el still means "above the nose". A single board can also be
            turned at run time, without a rebuild: !flip 1, then !save.

    config TARGETCAM_HMIRROR
        bool "Mirror the image horizontally"
        default n
        help
            Set together with VFLIP for a camera rotated 180 degrees, so that
            +az still means "right of the nose".

    choice TARGETCAM_PRESET
        prompt "Target colour preset"
        default TARGETCAM_PRESET_RED
        help
            Colour the detector looks for at boot. RED is the IAR-LARC waypoint
            colour (red mylar balloons); the others are for bench testing with
            other balloons. Changeable at runtime with 'p red', 'p blue',
            'p green' or 'p orange', or replaced entirely by 'c' (calibrate on
            whatever is in the centre of the view).

        config TARGETCAM_PRESET_RED
            bool "Red (hue 0 +/-12) - competition waypoints"
        config TARGETCAM_PRESET_BLUE
            bool "Blue (hue 220 +/-30)"
        config TARGETCAM_PRESET_GREEN
            bool "Green (hue 125 +/-35)"
        config TARGETCAM_PRESET_ORANGE
            bool "Orange (hue 25 +/-10)"
    endchoice

    config TARGETCAM_MIN_AREA
        int "Smallest blob reported (pixels)"
        range 1 19200
        default 25
        help
            25 px is about a 5.6 px circle, ~2 deg across at QQVGA. A 550 mm
            waypoint balloon still covers ~36 px at 12 m, more than the 10 m
            length of the arena. Smaller admits more false
            detections from coloured clutter.

    config TARGETCAM_TARGET_MM
        int "Target diameter for range estimate (mm, 0 = off)"
        range 0 5000
        default 550
        help
            If the target's real size is known, its apparent size gives a range.
            550 mm is the middle of the 50-60 cm the IAR-LARC rules give for the
            22-inch waypoint balloons. Only meaningful for a roughly round
            target seen whole: clipped targets report no range.

endmenu
```

## tools/lens_test/esp32cam/main/Kconfig.projbuild
```kconfig
menu "Lens test"

    choice LENS_TEST_WIFI_MODE
        prompt "Wi-Fi mode"
        default LENS_TEST_WIFI_AP
        help
            Access point: the board creates its own network and is always
            http://192.168.4.1/. Nothing to configure at the lab or the venue.
            Station: the board joins the router named below and prints its
            address on the serial console.

        config LENS_TEST_WIFI_AP
            bool "Access point (laptop joins the board)"
        config LENS_TEST_WIFI_STA
            bool "Station (board joins your router)"
    endchoice

    config LENS_TEST_WIFI_SSID
        string "Network name (SSID)"
        default "lens-test"

    config LENS_TEST_WIFI_PASSWORD
        string "Password (8+ characters, or empty for an open network)"
        default "lenstest1"

    config LENS_TEST_SERIAL_BAUD
        int "Serial rate for the PC tool on UART0 (after the boot log)"
        default 460800
        help
            The boot log stays at 115200 baud; the firmware then switches UART0
            to this rate for lens_test.py --port. 460800 is what the generic
            USB-C adapters on the bench are known to handle (esptool flashes at
            it); the one tried could not do 921600 at all.

    config LENS_TEST_JPEG_QUALITY
        int "JPEG quality for stills and stream (0 best .. 63 worst)"
        range 0 63
        default 10
        help
            esp32-camera's scale. 10 keeps the sharpness and vignetting numbers
            meaningful; below about 8 the OV2640's full-size frames can overflow
            the frame buffer and get dropped.

endmenu
```
