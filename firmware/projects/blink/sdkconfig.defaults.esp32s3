## firmware/projects/i2c_tools/main/Kconfig.projbuild
```kconfig
menu "Example Configuration"

    config EXAMPLE_STORE_HISTORY
        bool "Store command history in flash"
        default y
        help
            Linenoise line editing library provides functions to save and load
            command history. If this option is enabled, initializes a FAT filesystem
            and uses it to store command history.

    config EXAMPLE_I2C_MASTER_SCL
        int "SCL GPIO Num"
        default 19 if IDF_TARGET_ESP32
        default 5
        help
            GPIO number for I2C Master clock line.

    config EXAMPLE_I2C_MASTER_SDA
        int "SDA GPIO Num"
        default 18 if IDF_TARGET_ESP32
        default 4
        help
            GPIO number for I2C Master data line.

    config EXAMPLE_BLINK_GPIO
        int "Status LED GPIO number"
        range 0 48
        default 21
        help
            GPIO number driving the on-board addressable RGB LED. The LED
            sweeps through hues as a liveness indicator while the console
            runs. 21 is correct for the ESP32-S3-Zero.

    config EXAMPLE_BLINK_PERIOD
        int "Status LED hue period in ms"
        range 100 3600000
        default 3000
        help
            Time taken by one full revolution of the hue wheel.
endmenu

menu "Motor driver (DRV8833)"

    # Pin for pin as wired. Each motor takes two lines, and which of the two
    # counts as "forward" is set by how the motor leads and prop are fitted -
    # correct a backwards thruster by swapping its pair here, not by negating
    # the command upstream, so that the sign lives in one place.
    #
    # Remounted 2026-10-29: the motor on driver #1's OUT1/OUT2 is now the rear
    # left one and the one on OUT3/OUT4 the front left (driver #2 the same on
    # the right), and every motor turned the wrong way. So each motor took the
    # other pair of its driver, with IN1 and IN2 swapped to reverse it. Before:
    # FL 13/12, RL 11/10, FR 9/8, RR 7/14. An existing sdkconfig keeps the
    # numbers it has: set them in menuconfig, or delete it and run set-target.

    config MOTOR_FL_IN1_GPIO
        int "motor_FL IN1 - driver #1 IN4 GPIO"
        range 0 48
        default 10
    config MOTOR_FL_IN2_GPIO
        int "motor_FL IN2 - driver #1 IN3 GPIO"
        range 0 48
        default 11

    config MOTOR_RL_IN1_GPIO
        int "motor_RL IN1 - driver #1 IN2 GPIO"
        range 0 48
        default 12
    config MOTOR_RL_IN2_GPIO
        int "motor_RL IN2 - driver #1 IN1 GPIO"
        range 0 48
        default 13

    config MOTOR_FR_IN1_GPIO
        int "motor_FR IN1 - driver #2 IN4 GPIO"
        range 0 48
        default 14
    config MOTOR_FR_IN2_GPIO
        int "motor_FR IN2 - driver #2 IN3 GPIO"
        range 0 48
        default 7

    config MOTOR_RR_IN1_GPIO
        int "motor_RR IN1 - driver #2 IN2 GPIO"
        range 0 48
        default 8
    config MOTOR_RR_IN2_GPIO
        int "motor_RR IN2 - driver #2 IN1 GPIO"
        range 0 48
        default 9

    config MOTOR_POSITIONS
        string "Default position of the outputs FL RL FR RR, in core/'s frame"
        default "FR RR FL RL"
        help
            Where each of the four outputs above physically sits, named in
            core/'s frame seen from behind the blimp (FL = the surge motor on
            the blimp's own left). The control loop drives positions, not
            names (cmd_motor.h, the motor map), so a name can be anything the
            team likes and the heading loop still turns the right way.
            Measured 2026-10-30 on the rope rig: the IMU's axes and the yaw
            each surge motor produced put the output named FL on the blimp's
            right, so the names are mirrored against core/'s frame and the
            positions are "FR RR FL RL". 'motormap' changes this at run time
            and keeps it in NVS; this is the default after 'motormap reset'.

    config MOTOR_SIGNS
        string "Default direction sign of the outputs FL RL FR RR"
        default "+ + + +"
        help
            Per output, + or -: the command sign that pushes forward (surge
            pair) or up (heave pair). Measured 2026-10-30: + on all four.

    config MOTOR_NSLEEP_GPIO
        int "nSLEEP GPIO, or -1 if strapped high in hardware"
        range -1 48
        default -1
        help
            Both DRV8833s hold their outputs high-impedance while nSLEEP is
            low, so it must be high before any motor turns. Leave this at -1
            if the pin is tied to 3V3 on the board. Putting it on a GPIO buys
            a real all-off state and a way to clear a driver fault.

    config MOTOR_PWM_FREQ_HZ
        int "PWM carrier frequency in Hz"
        range 1000 100000
        default 20000
        help
            Above roughly 18 kHz the carrier is out of hearing, which matters
            on an airship whose envelope is an excellent sounding board. The
            DRV8833 accepts up to 250 kHz, but higher frequencies cost
            switching loss for no gain with motors this small. The driver
            picks the finest LEDC duty resolution this frequency allows: at
            20 kHz that is 11 bits, 2048 steps.

    config MOTOR_DEADBAND_PERMILLE
        int "Break-away duty in parts per thousand"
        range 0 900
        default 100
        help
            Smallest duty that actually starts the prop turning. Thrust
            commands are mapped onto [deadband, ceiling] so that a small
            command produces a small thrust instead of nothing at all.

            100 (10 %) since 2026-11-01: the team's bench setting from
            2026-10-30 on, with MOTOR_MAX_DUTY_PERCENT's 40, so a boot no
            longer leaves the motors unlimited until someone types
            'motor --max-duty 40 --deadband 10'. A command is then not its
            duty: c gives 10 + 30 |c| % (0.05 is 11.5 %), the ground
            station's sliders and the readback included. 0 means no mapping,
            a command is its duty, which the thrust stand and the step tests
            need (software/thrust_map.py and step_test.py refuse anything
            else: 'motor --max-duty 100 --deadband 0' for the run, and a
            reboot or 'motor --max-duty 40 --deadband 10' after it). It was
            the default from 2026-10-28; the 120 before that was an
            unmeasured guess that turned the smallest slider step (0.003)
            into 12.3 % duty. Measure the real value per motor with
            'motor -m FL --sweep'.

    config MOTOR_MAX_DUTY_PERCENT
        int "Duty ceiling, percent: what a command of 1.0 gives"
        range 10 100
        default 40
        help
            Commands are mapped onto [deadband, ceiling] instead of
            [deadband, 100 %], so a full command is this duty and nothing
            can exceed it. The team caps the motors to spare the drivers
            (1.2 A a channel): 30 % from 2026-10-30, 40 % from 2026-10-31,
            when the rear pair could not lift the trim at 30 %; the default
            since 2026-11-01, so a boot is already limited. 'motor
            --max-duty' changes it until the next reset, and the bench hold
            sets it with 'software/hold_test.py --max-duty 40'. With a
            ceiling, core/'s motor_max_thrust_n must be the thrust AT the
            ceiling (about 3.4 gf at 40 %, inferred on 2026-10-31), so that
            core/'s idea of a full command and the motor's agree. 100 with
            a 0 deadband keeps a command equal to its duty, which the thrust
            stand (software/thrust_map.py) and the step tests need; see
            MOTOR_DEADBAND_PERMILLE.

    config MOTOR_RAMP_MS
        int "Soft start: rest to a full command, ms; 0 disables"
        range 0 2000
        default 200
        help
            A motor at rest has no back-EMF, so at a given duty it draws
            several times its running current. With this set, a start
            begins at the deadband and the duty climbs to the command over
            this long (a rise on a running motor keeps the same slope), a
            stop or a decrease lands at once, and turning the other way
            waits until the motor has coasted this long (main/motor_ramp.h).
            Added 2026-10-31: at the team's 40 % ceiling a stalled start
            asked an estimated 1.8 A of a driver channel the team keeps
            under 1.2 A, and the rear pair stopped starting above 28-34 %
            duty. 200 ms is twice the ~0.1 s a motor takes to spin up.
            'motor --ramp-ms' changes it until the next reset; 0 lands every
            command on the pins at once, as before.

    config MOTOR_FAILSAFE_MS
        int "Coast all motors after this long with no command; 0 disables"
        range 0 60000
        default 1000
        help
            The PWM peripheral holds the last duty forever, so a controller
            that stops running leaves the airship under full thrust. This
            timer is what makes that failure stop the motors instead.

endmenu

menu "Wireless link (Wi-Fi access point + UDP)"

    # The blimp is its own access point: the laptop joins it, no router
    # involved. See net_wifi.c for why this and not ESP-NOW.

    config NET_WIFI_AT_BOOT
        bool "Start the access point at boot"
        default y
        help
            Off, the radio stays down until 'wifi --start' is typed on the
            USB console - useful on a USB-only bench to keep the current
            draw out of the picture while probing the sensor rail.

    config NET_WIFI_SSID_PREFIX
        string "SSID prefix"
        default "ICARUS"
        help
            The SSID is this prefix, a dash and the last three bytes of the
            board's Wi-Fi MAC in hex, e.g. ICARUS-A1B2C3, so two boards in
            one room are distinguishable.

    config NET_WIFI_PASSWORD
        string "WPA2 key"
        default "icarusblimp"
        help
            8 to 63 characters. Empty makes the network open, which is a
            bench-only setting: the key is the only thing between a stray
            phone and the 'motor' command.

    config NET_WIFI_CHANNEL
        int "Channel"
        range 1 13
        default 1
        help
            Fixed on purpose, so the laptop never has to follow a channel
            change. Survey the venue's 2.4 GHz band before picking the one
            for competition day.

    config NET_WIFI_MAX_STA
        int "Maximum stations"
        range 1 4
        default 2
        help
            One ground station plus a spare. The link replies to the last
            host that sent a valid packet, so more stations do not mean more
            simultaneous operators.

    config NET_LINK_PORT
        int "UDP port for command/telemetry packets"
        range 1024 65535
        default 7200

    config NET_CONSOLE_PORT
        int "UDP port for the text console"
        range 1024 65535
        default 7201

    config NET_LINK_TIMEOUT_MS
        int "Coast motors driven over the link after this long without a packet"
        range 100 5000
        default 500
        help
            Independent of the motor driver's own failsafe
            (MOTOR_FAILSAFE_MS), which only counts thrust commands. This one
            counts any valid packet and only acts on motors that were last
            commanded over the air; see net_link.c.

    config NET_LINK_TELEMETRY_HZ
        int "Telemetry rate in Hz"
        range 1 100
        default 20

endmenu

menu "Sensor stream (the packet the ground station plots)"

    # sensor_stream.c samples every sensor through the same drivers as the
    # console commands and hands the latest reading to net_link.c, which
    # sends it as LINK_PKT_SENSORS. A console sensor command pauses the
    # stream and takes the chip for its own run either way.

    config SENSOR_STREAM_AT_BOOT
        bool "Sample the sensors from boot"
        default y
        help
            Off, nothing touches the chips until 'sensors --on' is typed, for
            a bench where the console commands should own them, or to keep
            the bus quiet while probing the sensor rail.

    config SENSOR_STREAM_HZ
        int "Sample and packet rate in Hz"
        range 1 50
        default 50
        help
            The IMU, the magnetometer and the rangefinder are polled at this
            rate; the barometer runs on its own slower schedule, see
            sensor_stream.c. Bounded above by the 10 ms FreeRTOS tick: 50 Hz
            is two ticks. The link sends at most one SENSORS packet per
            telemetry tick (NET_LINK_TELEMETRY_HZ), so a faster stream only
            means fresher samples, not more packets.

            50 Hz, the control loop's own rate, since 2026-10-28: the loop
            peeks this stream's latest sample every 20 ms, and at the old
            20 Hz two or three records in a row carried the same IMU
            sample, which read as steps in the traces. At 50 Hz every record
            can carry a new one. Not yet run on hardware at this rate.

endmenu

menu "Control task"

    config CTL_STATS_AT_BOOT
        bool "Print the control task's timing line once a second from boot"
        default n
        help
            ctl_task.c measures its own period and execution time in
            one-second windows. Printed every second, that line buries
            everything else typed on the USB console, so it starts off:
            'ctl' shows the last window on demand, and 'ctl --stats on'
            turns the line on until the next reset (the increment 1 bench
            check). Say y for a session spent watching the timing.

    config CTL_IMU_AXES
        string "IMU mounting: the chip axis along body x, y, z"
        default "-Y +X +Z"
        help
            How the MPU-6050 sits on the gondola, as the chip axis (with its
            sign) that points along core/'s body x (forward), y (left) and
            z (up), in that order. "-Y +X +Z" means forward is the chip's -y,
            left its +x and up its +z: measured 2026-10-30 on the rope rig
            (nose up, left side up and a counter-clockwise turn, gyro and
            accelerometer agreeing). Re-measure after any remount: a wrong
            map turns the heading loop round.

    config CTL_MAG_AXES
        string "Magnetometer mounting: the chip axis along body x, y, z"
        default "+X +Y +Z"
        help
            As CTL_IMU_AXES, for the magnetometer. Fitted 2026-10-30 from the
            gyro during the same moves: its axes already point forward, left
            and up. The fit cannot tell this map from its mirror image; the
            mirror needs a left-handed chip, so this one is taken.

endmenu

menu "Battery monitor (the motor cell's divider)"

    # cmd_battery.c: one ADC conversion per control tick, read by the
    # control task's read stage and written into every capture record.
    # The divider ratio and the averaging move into params_t with
    # increment 2 of docs/control-loop-plan.md (D10).

    config BATTERY_ADC_GPIO
        int "Divider GPIO (ADC1 only)"
        range 1 10
        default 1
        help
            GPIO1 is ADC1_CH0, the pin the wiring plan gives the motor
            battery divider (docs/s3-wroom-cam-wiring-plan.md). Only ADC1
            (GPIO1-10 on the S3) works here: Wi-Fi takes ADC2.

    config BATTERY_DIVIDER_PERMILLE
        int "Divider ratio x1000 (battery voltage / pin voltage)"
        range 1000 10000
        default 2000
        help
            2000 for the planned 100 k + 100 k. A 4.2 V cell then puts
            2.1 V on the pin, inside the 12 dB range. Replace the nominal
            value with the one measured against a multimeter.

    config BATTERY_AVG_TICKS
        int "Running average length in control ticks (20 ms each)"
        range 1 64
        default 25
        help
            Boxcar over the last this-many samples: 25 is 0.5 s, so a
            thrust step shows up in the average within 0.5 s and the
            average lags the cell by 250 ms. The capture records the
            average; 'battery' also shows the last single sample.

endmenu

menu "Forward camera (target_cam over UART)"

    # cam_link.c reads the forward ESP32-CAM's detections: the CSV rows that
    # namontoy's target_cam firmware copies to the CAM's UART1 (TX IO14, since
    # 2026-10-31), 12.5 a second. The S3 pins are the Cableado's
    # (docs/inter-board-link-plan.md): UART1, RX on GPIO6, TX on GPIO2.

    config CAM_FWD_UART_RX_GPIO
        int "S3 RX GPIO (from the CAM's IO14)"
        range 0 48
        default 6
        help
            The camera's rows arrive here. Through 470 ohm in series, per the
            link plan. -1 is not accepted: without the receive pin there is
            nothing to do.

    config CAM_FWD_UART_TX_GPIO
        int "S3 TX GPIO (to the CAM's IO13), or -1 for none"
        range -1 48
        default 2
        help
            Only 'cam --tx' sends anything, a line typed by a person: the S3
            never writes to the camera on its own, because target_cam takes
            single-letter commands ('s' turns its rows off). -1 leaves the
            pin alone, for a receive-only wiring.

    config CAM_FWD_UART_BAUD
        int "Baud rate"
        range 9600 2000000
        default 115200
        help
            target_cam boots at 115200 and keeps it unless its PC viewer
            switches it (and that switch reverts by itself if the viewer
            goes quiet).

    config CAM_FWD_BEARING_SIGN
        int "core/'s bearing = this sign x the camera's az"
        range -1 1
        default -1
        help
            target_cam's az is + when the balloon is RIGHT of the image
            centre; core/'s bearing is + counter-clockwise, to the LEFT. -1
            for a camera mounted upright and not mirrored. Check it on the
            bench (balloon on the blimp's left: 'cam' must show a + bearing)
            and change it live with 'cam --sign' until the next boot.

endmenu

menu "Downward camera (optflow_cam over UART2)"

    # cam_link.c reads the downward ESP32-CAM's optical flow: the CSV rows that
    # optflow_cam copies to the CAM's IO14 (CONFIG_OPTFLOW_S3_UART, since
    # 2026-11-02), about 12.5 a second. The S3 pins are the link plan's
    # CAM-DOWN (docs/inter-board-link-plan.md): UART2, TX on GPIO17, RX on
    # GPIO18, the back pads of the S3-Zero. UART2 has no IO-MUX pins, so
    # cam_link.c always routes it with uart_set_pin(). Either port takes either
    # camera's rows (the column count picks the mailbox), so swapped cables
    # still work; 'cam' says which port each kind arrived on.

    config CAM_DOWN_UART_RX_GPIO
        int "S3 RX GPIO (from the downward CAM's IO14)"
        range 0 48
        default 18
        help
            The flow rows arrive here, through 470 ohm in series, with the
            pull-up cam_link.c enables (the plan also allows an external
            10 k to 3.3 V). Not a strapping pin: IO14 toggles while the camera
            boots, and the S3 counts those bytes as rejected.

    config CAM_DOWN_UART_TX_GPIO
        int "S3 TX GPIO (to the downward CAM's IO13), or -1 for none"
        range -1 48
        default 17
        help
            optflow_cam does not read its IO13, so this wire is optional;
            only 'cam --tx-down', a line a person typed, writes to it. Leave
            it unwired until the camera reads it: the S3 configures the UART
            at boot, and an idle-high TX feeds an unpowered camera through
            its pin (docs/inter-board-link-plan.md, "S3 rule for every
            phase"). -1 leaves the pin alone.

    config CAM_DOWN_UART_BAUD
        int "Baud rate"
        range 9600 2000000
        default 115200
        help
            CONFIG_OPTFLOW_S3_UART_BAUD on the camera: 115200 by default. A
            16-column row is about 70 characters, so 12.5 rows a second use
            under a tenth of the line.

endmenu

menu "Capture (the control loop's records, kept in PSRAM)"

    # capture.c stores one 72-byte log record per 20 ms tick of the control
    # task, for a bench session, and the link reads them back afterwards
    # ('capture' on the console, blimp_link.py capture, the ground station's
    # Bench page).

    config CAPTURE_MAX_SECONDS
        int "Longest capture in seconds"
        range 1 600
        default 400
        help
            The buffer is allocated once at boot for this many seconds of
            records: 3.6 kB per second (72 bytes at 50 Hz), so 400 s is
            1.4 MB of the 1594 kB of PSRAM measured free on 2026-10-27 with
            Wi-Fi up. A capture asks for its own length at start, up to
            this; a longer request is refused, not shortened. If this much
            cannot be allocated the firmware takes the largest free PSRAM
            block instead, then falls back to a 10 s buffer in internal RAM,
            and says so in the boot log either way. The ground station reads
            the real limit from the blimp. Longer than the buffer means
            streaming the records as they are made, not implemented.

endmenu
```
